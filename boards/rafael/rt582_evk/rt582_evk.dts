/* Copyright (c) 2024 Rafael Microelectronics Inc. */
/* SPDX-License-Identifier: Apache-2.0 */

/dts-v1/;
#include <rafael/rt582.dtsi>

/ {
	model = "Rafael Micro RT582 EVK";
	compatible = "rafael,rt582-evk";

	chosen {
		zephyr,console = &uart0;
		zephyr,shell-uart = &uart0;
		zephyr,sram = &sram0;
		zephyr,flash = &flash0;
	};
};

&uart0 {
	status = "okay";
	current-speed = <115200>;
};
