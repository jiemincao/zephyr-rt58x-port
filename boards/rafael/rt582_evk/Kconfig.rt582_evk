## boards/rafael/rt582_evk/Kconfig.rt582_evk
```kconfig
# Copyright (c) 2016 Zephyr Contributors
# SPDX-License-Identifier: Apache-2.0

config BOARD_RT582_EVK
	select SOC_RT582
```

## boards/rafael/rt582_evk/board.yml
```yaml
board:
  name: rt582_evk
  vendor: rafael
  # revision:
  #   format: <major.minor.patch|letter|number|custom>
  #   default: <default-revision-value>
  #   exact: <true|false>
  #   revisions:
  #   - name: <revA>
  socs:
  - name: rt582
    # variants:
    # - name: <variant-1>
    #   variants:
    #   - name: <sub-variant-2-1>
```

## drivers/serial/Kconfig.rt58x
```kconfig
# SPDX-License-Identifier: Apache-2.0

config UART_RT58X
    bool "Rafael Micro RT58x UART driver"
    default y
    depends on DT_HAS_RAFAEL_RT58X_UART_ENABLED
    select SERIAL_HAS_DRIVER
    select SERIAL_SUPPORT_INTERRUPT
    help
      Enable the UART driver for the RT58X SoC.
```

## dts/bindings/serial/rafael,rt58x-uart.yaml
```yaml
description: Rafael Micro RT58x UART

compatible: "rafael,rt58x-uart"

include: uart-controller.yaml

properties:
  reg:
    required: true

  interrupts:
    required: true
```

## soc/rafael/Kconfig
```kconfig
# Copyright (c) 2024 STMicroelectronics
# SPDX-License-Identifier: Apache-2.0

config SOC_FAMILY_RT58X

if SOC_FAMILY_RT58X

rsource "*/Kconfig"

endif # SOC_FAMILY_RT58X
```

## soc/rafael/Kconfig.soc
```kconfig
# ST Microelectronics STM32 MCU line

# Copyright (c) 2016 Open-RnD Sp. z o.o.
# SPDX-License-Identifier: Apache-2.0

config SOC_FAMILY_RT58X
        bool

config SOC_SERIES_RT582
        bool
        select SOC_FAMILY_RT58X

config SOC_FAMILY
        default "rt58x" if SOC_FAMILY_RT58X

config SOC_SERIES
        default "rt582" if SOC_SERIES_RT582

config SOC
        default "rt582" if SOC_RT582

rsource "*/Kconfig.soc"
```

## soc/rafael/rt58x/Kconfig
```kconfig
# ST Microelectronics STM32F1 MCU series

# Copyright (c) 2016 Open-RnD Sp. z o.o.
# SPDX-License-Identifier: Apache-2.0

config SOC_RT582
	select ARM
	select CPU_CORTEX_M3
	select CPU_HAS_MPU
	select CMSIS
	select HAS_CMSIS_CORE
```

## soc/rafael/rt58x/Kconfig.defconfig
```kconfig
# SPDX-License-Identifier: Apache-2.0

if SOC_RT582

config NUM_IRQS
	default 32

endif # SOC_RT582
```

## soc/rafael/rt58x/Kconfig.soc
```kconfig
# ST Microelectronics STM32F1 MCU line

# Copyright (c) 2016 Open-RnD Sp. z o.o.
# Copyright (c) RnDity Sp. z o.o.
# SPDX-License-Identifier: Apache-2.0

config SOC_SERIES_RT582
	bool
	select SOC_FAMILY_RT58X

config SOC_SERIES
	default "rt582" if SOC_SERIES_RT582

config SOC_RT582
	bool
	select SOC_SERIES_RT582
	
config SOC
	default "rt582" if SOC_RT582
```
